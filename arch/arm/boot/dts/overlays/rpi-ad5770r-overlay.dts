/dts-v1/;
/plugin/;

/ {
	compatible = "brcm,bcm2708";

	fragment@0 {
		target = <&spi0>;
		__overlay__ {
			#address-cells = <1>;
			#size-cells = <0>;
			status = "okay";

			ad5770r@0 {
				compatible = "ad5770r";
				reg = <0>;
				spi-max-frequency = <1000000>;

				reset-gpios = <&gpio 22 0>;

				adi,output = [00 02 00 00 00 00];
				adi,alarm = [00 00 00 00 00 00 00 00];
				adi,monitor = [00 00 00 00];
				adi,ref_voltage = [01];
				adi,external_ref = [00];
				adi,channel_cfg = [01 01 01 01 01 01 00];
				adi,channel_enable = [01 01 01 01 01 01];
			};
		};
	};
};




